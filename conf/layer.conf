## conf/layer.conf
```bitbake
# We have a conf and classes directory, add to BBPATH
BBPATH .= ":${LAYERDIR}"

# We have recipes-* directories, add to BBFILES
BBFILES += "${LAYERDIR}/recipes-*/*/*.bb \
	${LAYERDIR}/recipes-*/*/*.bbappend"

BBFILE_COLLECTIONS += "softwares-sv"
BBFILE_PATTERN_softwares-sv = "^${LAYERDIR}/"
BBFILE_PRIORITY_softwares-sv = "6"
```
